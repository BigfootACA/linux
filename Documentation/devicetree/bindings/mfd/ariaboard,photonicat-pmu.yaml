## Documentation/devicetree/bindings/mfd/ariaboard,photonicat-pmu.yaml
```yaml
# SPDX-License-Identifier: (GPL-2.0 OR BSD-2-Clause)
%YAML 1.2
---
$id: http://devicetree.org/schemas/mfd/ariaboard,photonicat-pmu.yaml#
$schema: http://devicetree.org/meta-schemas/core.yaml#

title: Ariaboard Photonicat PMU

maintainers:
  - Junhao Xie <bigfoot@classfun.cn>

description:
  The Power Management MCU in Ariaboard Photonicat which
  provides battery and charger power supply real-time clock,
  watchdog, hardware shutdown, status leds.

$ref: /schemas/power/supply/power-supply.yaml

properties:
  compatible:
    const: ariaboard,photonicat-pmu

  current-speed:
    $ref: /schemas/types.yaml#/definitions/uint32
    default: 115200
    description: PMU Serial baudrate

  monitored-battery: true

required:
  - compatible
  - monitored-battery

additionalProperties: false

examples:
  - |
      battery: battery {
          compatible = "simple-battery";
          voltage-max-design-microvolt = <4200000>;
          voltage-min-design-microvolt = <3400000>;
      };

      serial {
          photonicat-pmu {
              compatible = "ariaboard,photonicat-pmu";
              current-speed = <115200>;
              monitored-battery = <&battery>;
          };
      };
```

## Documentation/devicetree/bindings/net/can/rockchip,rk3568v2-canfd.yaml
```yaml
# SPDX-License-Identifier: (GPL-2.0-only OR BSD-2-Clause)
%YAML 1.2
---
$id: http://devicetree.org/schemas/net/can/rockchip,rk3568v2-canfd.yaml#
$schema: http://devicetree.org/meta-schemas/core.yaml#

title:
  Rockchip CAN-FD controller

maintainers:
  - Marc Kleine-Budde <mkl@pengutronix.de>

allOf:
  - $ref: can-controller.yaml#
  - if:
      properties:
        compatible:
          contains:
            const: rockchip,rk3576-canfd
      required:
        - compatible
    then:
      required:
        - dmas
        - dma-names
    else:
      properties:
        dmas: false
        dma-names: false

properties:
  compatible:
    oneOf:
      - const: rockchip,rk3568v2-canfd
      - const: rockchip,rk3576-canfd
      - items:
          - const: rockchip,rk3568v3-canfd
          - const: rockchip,rk3568v2-canfd

  reg:
    maxItems: 1

  interrupts:
    maxItems: 1

  clocks:
    maxItems: 2

  clock-names:
    items:
      - const: baud
      - const: pclk

  resets:
    maxItems: 2

  reset-names:
    items:
      - const: core
      - const: apb

  dmas:
    maxItems: 1

  dma-names:
    items:
      - const: rx

required:
  - compatible
  - reg
  - interrupts
  - clocks
  - resets

additionalProperties: false

examples:
  - |
    #include <dt-bindings/clock/rk3568-cru.h>
    #include <dt-bindings/interrupt-controller/arm-gic.h>
    #include <dt-bindings/interrupt-controller/irq.h>

    soc {
        #address-cells = <2>;
        #size-cells = <2>;

        can@fe570000 {
            compatible = "rockchip,rk3568v2-canfd";
            reg = <0x0 0xfe570000 0x0 0x1000>;
            interrupts = <GIC_SPI 1 IRQ_TYPE_LEVEL_HIGH>;
            clocks = <&cru CLK_CAN0>, <&cru PCLK_CAN0>;
            clock-names = "baud", "pclk";
            resets = <&cru SRST_CAN0>, <&cru SRST_P_CAN0>;
            reset-names = "core", "apb";
        };
    };

  - |
    soc {
        #address-cells = <2>;
        #size-cells = <2>;

        can@2ac00000 {
            compatible = "rockchip,rk3576-canfd";
            reg = <0x0 0x2ac00000 0x0 0x1000>;
            interrupts = <GIC_SPI 121 IRQ_TYPE_LEVEL_HIGH>;
            clocks = <&cru CLK_CAN0>, <&cru PCLK_CAN0>;
            clock-names = "baud", "pclk";
            resets = <&cru SRST_CAN0>, <&cru SRST_P_CAN0>;
            reset-names = "core", "apb";
            dmas = <&dmac0 20>;
            dma-names = "rx";
        };
    };
```

## drivers/pmdomain/sunxi/Kconfig
```kconfig
# SPDX-License-Identifier: GPL-2.0-only

config SUN20I_PPU
	bool "Allwinner D1 PPU power domain driver"
	depends on ARCH_SUNXI || COMPILE_TEST
	depends on PM
	select PM_GENERIC_DOMAINS
	help
	  Say y to enable the PPU power domain driver. This saves power
	  when certain peripherals, such as the video engine, are idle.

config SUN50I_GPU_PD
	tristate "Allwinner H616 GPU power domain driver"
	depends on ARCH_SUNXI || COMPILE_TEST
	depends on PM
	select PM_GENERIC_DOMAINS
	help
	  Say y to enable the GPU power domain driver.
```

## drivers/staging/media/sunxi/cedrus/Kconfig
```kconfig
# SPDX-License-Identifier: GPL-2.0
config VIDEO_SUNXI_CEDRUS
	tristate "Allwinner Cedrus Video Engine Driver"
	depends on V4L_PLATFORM_DRIVERS && VIDEO_DEV
	depends on ARCH_SUNXI || COMPILE_TEST
	depends on PM && COMMON_CLK && RESET_CONTROLLER && HAS_DMA
	select MEDIA_CONTROLLER
	select MEDIA_CONTROLLER_REQUEST_API
	select VIDEOBUF2_DMA_CONTIG
	select V4L2_MEM2MEM_DEV
	select SUNXI_SRAM
	help
	  Support for the Allwinner Video Engine.

	  To compile this driver as a module, choose M here: the module
	  will be called sunxi-cedrus.
```
