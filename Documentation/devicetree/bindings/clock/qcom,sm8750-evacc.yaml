## Documentation/devicetree/bindings/clock/qcom,sm8750-evacc.yaml
```yaml
# SPDX-License-Identifier: GPL-2.0-only OR BSD-2-Clause
%YAML 1.2
---
$id: http://devicetree.org/schemas/clock/qcom,sm8750-evacc.yaml#
$schema: http://devicetree.org/meta-schemas/core.yaml#

title: Qualcomm EVA Clock Controller on SM8750

maintainers:
  - Stephen Boyd <sboyd@kernel.org>
  - Taniya Das <quic_tdas@quicinc.com>

description: |
  Qualcomm EVA clock control module provides the clocks, resets and power
  domains for the computer vision subsystem on SM8750.

  See also: include/dt-bindings/clock/qcom,sm8750-evacc.h

properties:
  compatible:
    const: qcom,sm8750-evacc

  clocks:
    items:
      - description: Board XO source
      - description: Board active-only XO source
      - description: Sleep clock source

  power-domains:
    items:
      - description: MMCX power domain
      - description: MXC power domain

  required-opps:
    items:
      - description: MMCX performance point
      - description: MXC performance point

required:
  - compatible
  - clocks
  - power-domains
  - '#clock-cells'
  - '#reset-cells'
  - '#power-domain-cells'

allOf:
  - $ref: qcom,gcc.yaml#

unevaluatedProperties: false

examples:
  - |
    #include <dt-bindings/clock/qcom,rpmh.h>
    #include <dt-bindings/power/qcom,rpmhpd.h>

    clock-controller@abf0000 {
        compatible = "qcom,sm8750-evacc";
        reg = <0x0abf0000 0x10000>;
        clocks = <&bi_tcxo_div2>,
                 <&bi_tcxo_ao_div2>,
                 <&sleep_clk>;
        power-domains = <&rpmhpd RPMHPD_MMCX>,
                        <&rpmhpd RPMHPD_MXC>;
        required-opps = <&rpmhpd_opp_low_svs>,
                        <&rpmhpd_opp_low_svs>;
        #clock-cells = <1>;
        #reset-cells = <1>;
        #power-domain-cells = <1>;
    };
```

## Documentation/devicetree/bindings/display/bridge/lontium,lt8712sx.yaml
```yaml
# SPDX-License-Identifier: (GPL-2.0-only OR BSD-2-Clause)
%YAML 1.2
---
$id: http://devicetree.org/schemas/display/bridge/lontium,lt8712sx.yaml#
$schema: http://devicetree.org/meta-schemas/core.yaml#

title: Lontium LT8712SX/LT8713SX eDP to HDMI Bridge

maintainers:
  - Chen Jiali <chenjiali@radxa.com>

properties:
  compatible:
    enum:
      - lontium,lt8712sx
      - lontium,lt8713sx

  reg:
    maxItems: 1

  cec-port-names:
    $ref: /schemas/types.yaml#/definitions/string-array
    description:
      HDMI connector port names used to create named CEC notifiers for boards
      that route multiple HDMI CEC lines to GPIO CEC adapters. The names must
      be distinct.
    minItems: 1
    maxItems: 2

  enable-gpios:
    maxItems: 1

  power-gpios:
    maxItems: 1

  pinctrl-0: true

  pinctrl-names:
    items:
      - const: default

  reset-gpios:
    maxItems: 1

  vdd-supply:
    description: Power supply for the bridge.

  ports:
    $ref: /schemas/graph.yaml#/properties/ports

    properties:
      port@0:
        $ref: /schemas/graph.yaml#/properties/port
        description: eDP input port.

      port@1:
        $ref: /schemas/graph.yaml#/properties/port
        description:
          HDMI output port. Optional. The bridge terminates the HDMI HPD and
          DDC lines itself, so on boards that do not route them to the SoC
          there is nothing a downstream connector could detect and the graph
          is left terminated at the bridge. Boards that fan the single output
          stream out to two HDMI connectors also describe no output port -
          both connectors carry the same stream.

    required:
      - port@0

required:
  - compatible
  - reg
  - ports

additionalProperties: false

examples:
  - |
    #include <dt-bindings/gpio/gpio.h>

    i2c {
        #address-cells = <1>;
        #size-cells = <0>;

        hdmi-bridge@4f {
            compatible = "lontium,lt8712sx";
            reg = <0x4f>;
            cec-port-names = "HDMI0", "HDMI1";
            vdd-supply = <&vcc_3v3>;
            reset-gpios = <&gpio 1 GPIO_ACTIVE_LOW>;

            ports {
                #address-cells = <1>;
                #size-cells = <0>;

                port@0 {
                    reg = <0>;

                    bridge_in: endpoint {
                        remote-endpoint = <&edp_out>;
                    };
                };
            };
        };
    };

...
```

## Documentation/devicetree/bindings/display/panel/novatek,nt36532.yaml
```yaml
# SPDX-License-Identifier: GPL-2.0-only OR BSD-2-Clause
%YAML 1.2
---
$id: http://devicetree.org/schemas/display/panel/novatek,nt36532.yaml#
$schema: http://devicetree.org/meta-schemas/core.yaml#

title: Novatek NT36532 based DSI display panels

maintainers:
  - BigfootACA <bigfoot@classfun.cn>

description:
  The Novatek NT36532 is a TDDI (touch and display driver integration) DSI
  panel IC. The panels described here are dual-DSI DSC video mode modules,
  second-sourced from BOE Technology and China Star Optoelectronics
  Technology (CSOT).

allOf:
  - $ref: panel-common-dual.yaml#

properties:
  compatible:
    items:
      - enum:
          - xiaomi,p81-boe
          - xiaomi,p81-csot
      - const: novatek,nt36532

  reg:
    maxItems: 1

  reset-gpios:
    maxItems: 1

  lcd-id-gpios:
    description:
      Strapping pin that tells the second sourced modules apart. When present
      it overrides the module selected by the compatible.
    maxItems: 1

  vddi-supply:
    description: logic supply for the panel and the driver IC

  backlight: true
  ports: true

required:
  - compatible
  - reg
  - vddi-supply
  - reset-gpios
  - ports

unevaluatedProperties: false

examples:
  - |
    #include <dt-bindings/gpio/gpio.h>

    dsi {
        #address-cells = <1>;
        #size-cells = <0>;

        panel@0 {
            compatible = "xiaomi,p81-boe", "novatek,nt36532";
            reg = <0>;

            vddi-supply = <&vreg_l12b_1p9>;
            reset-gpios = <&tlmm 98 GPIO_ACTIVE_LOW>;
            lcd-id-gpios = <&tlmm 100 GPIO_ACTIVE_HIGH>;
            backlight = <&backlight_primary>;

            ports {
                #address-cells = <1>;
                #size-cells = <0>;

                port@0 {
                    reg = <0>;
                    panel_in_0: endpoint {
                        remote-endpoint = <&mdss_dsi0_out>;
                    };
                };

                port@1 {
                    reg = <1>;
                    panel_in_1: endpoint {
                        remote-endpoint = <&mdss_dsi1_out>;
                    };
                };
            };
        };
    };

...
```

## Documentation/devicetree/bindings/input/nanosic,803.yaml
```yaml
# SPDX-License-Identifier: (GPL-2.0-only OR BSD-2-Clause)
%YAML 1.2
---
$id: http://devicetree.org/schemas/input/nanosic,803.yaml#
$schema: http://devicetree.org/meta-schemas/core.yaml#

title: Nanosic 803 keyboard MCU

maintainers:
  - Junhao Xie <bigfoot@radxa.com>

description:
  The Nanosic 803 sits behind the magnetic pogo connector of tablets such as
  the Xiaomi Pad 8 Pro and multiplexes a detachable keyboard, its Precision
  Touchpad, a consumer control page and vendor status reports onto a single
  I2C slave. The MCU has no flash-resident application, so the host has to
  upload a RAM image over I2C after every reset before any report is produced.

properties:
  compatible:
    const: nanosic,803

  reg:
    maxItems: 1

  interrupts:
    maxItems: 1
    description: Asserted by the MCU when a report is pending.

  vdd-supply:
    description: Main 3.3V supply, also feeds the pogo connector.

  dvdd-supply:
    description: 1.8V supply for the I2C and GPIO interface.

  reset-gpios:
    maxItems: 1
    description: Reset input of the MCU.

  sleep-gpios:
    maxItems: 1
    description:
      Driven low to ask the MCU to enter its low power state, high to run.

  wakeup-gpios:
    maxItems: 1
    description:
      Asserted by the MCU before it sends a report. It is used as a wakeup
      interrupt so that typing on the keyboard resumes the system.

  wakeup-source: true

required:
  - compatible
  - reg
  - interrupts
  - vdd-supply
  - reset-gpios
  - sleep-gpios

additionalProperties: false

examples:
  - |
    #include <dt-bindings/gpio/gpio.h>
    #include <dt-bindings/interrupt-controller/irq.h>

    i2c {
        #address-cells = <1>;
        #size-cells = <0>;

        keyboard@4c {
            compatible = "nanosic,803";
            reg = <0x4c>;

            interrupts-extended = <&tlmm 97 IRQ_TYPE_EDGE_RISING>;

            vdd-supply = <&vreg_l14b_3p3>;
            dvdd-supply = <&vreg_l11b_1p8>;

            reset-gpios = <&tlmm 188 GPIO_ACTIVE_LOW>;
            sleep-gpios = <&tlmm 3 GPIO_ACTIVE_HIGH>;
            wakeup-gpios = <&tlmm 95 GPIO_ACTIVE_HIGH>;

            pinctrl-0 = <&kbd_default>;
            pinctrl-names = "default";
        };
    };
```

## Documentation/devicetree/bindings/input/touchscreen/novatek,nt36532.yaml
```yaml
# SPDX-License-Identifier: GPL-2.0-only OR BSD-2-Clause
%YAML 1.2
---
$id: http://devicetree.org/schemas/input/touchscreen/novatek,nt36532.yaml#
$schema: http://devicetree.org/meta-schemas/core.yaml#

title: Novatek NT36532 SPI touchscreen controller

maintainers:
  - BigfootACA <bigfoot@classfun.cn>

description:
  The Novatek NT36532 is the touch half of a TDDI controller that also acts as
  the display driver IC. It has no reset pin of its own: the panel drives the
  reset line of the shared die, so this device has to be linked to its panel to
  be brought up again after every display power cycle.

allOf:
  - $ref: touchscreen.yaml#
  - $ref: /schemas/spi/spi-peripheral-props.yaml#

properties:
  compatible:
    const: novatek,nt36532

  reg:
    maxItems: 1

  interrupts:
    maxItems: 1

  panel:
    $ref: /schemas/types.yaml#/definitions/phandle
    description:
      Phandle to the panel this controller shares its die with.

  vdd-supply:
    description: analog supply, AVDD

  vddio-supply:
    description: digital and interface supply

required:
  - compatible
  - reg
  - interrupts
  - panel
  - vdd-supply
  - vddio-supply
  - touchscreen-size-x
  - touchscreen-size-y

unevaluatedProperties: false

examples:
  - |
    #include <dt-bindings/gpio/gpio.h>
    #include <dt-bindings/interrupt-controller/irq.h>

    spi {
        #address-cells = <1>;
        #size-cells = <0>;

        touchscreen@0 {
            compatible = "novatek,nt36532";
            reg = <0>;
            spi-max-frequency = <19200000>;

            interrupt-parent = <&tlmm>;
            interrupts = <162 IRQ_TYPE_EDGE_RISING>;

            vdd-supply = <&touch_avdd>;
            vddio-supply = <&vreg_l12b_1p9>;

            panel = <&panel0>;

            touchscreen-size-x = <2136>;
            touchscreen-size-y = <3200>;
            touchscreen-swapped-x-y;
        };
    };

...
```

## Documentation/devicetree/bindings/leds/backlight/kinetic,ktz8866.yaml
```yaml
# SPDX-License-Identifier: (GPL-2.0 OR BSD-2-Clause)
%YAML 1.2
---
$id: http://devicetree.org/schemas/leds/backlight/kinetic,ktz8866.yaml#
$schema: http://devicetree.org/meta-schemas/core.yaml#

title: Kinetic Technologies KTZ8866 backlight

maintainers:
  - Jianhua Lu <lujianhua000@gmail.com>

description: |
  The Kinetic Technologies KTZ8866 is a high efficiency 6-channels-current-sinks
  led backlight with dual lcd bias power.
  https://www.kinet-ic.com/ktz8866/

allOf:
  - $ref: common.yaml#
  - if:
      not:
        required:
          - kinetic,follower-mode
    then:
      required:
        - enable-gpios
  # A chip cannot be a follower and drive one at the same time
  - if:
      required:
        - kinetic,follower-mode
    then:
      properties:
        kinetic,follower: false

properties:
  compatible:
    const: kinetic,ktz8866

  reg:
    maxItems: 1

  vddpos-supply:
    description: positive boost supply regulator.

  vddneg-supply:
    description: negative boost supply regulator.

  enable-gpios:
    description: GPIO to use to enable/disable the backlight (HWEN pin).
    maxItems: 1

  current-num-sinks:
    description: number of the LED current sinks' channels.
    $ref: /schemas/types.yaml#/definitions/uint32
    enum: [1, 2, 3, 4, 5, 6]

  kinetic,current-ramp-delay-ms:
    description: |
      LED current ramping delay time in milliseconds, note that the
      case 1 will be mapped to 1μs.
    enum: [1, 2, 4, 8, 16, 32, 64, 128, 192, 256, 320, 384, 448, 512, 576, 640]

  kinetic,led-enable-ramp-delay-ms:
    description: |
      LED on/off ramping delay time in milliseconds, note that the case 0 will be
      mapped to 512μs because ktz8866 can't ramp faster than it.
    enum: [0, 1, 2, 4, 8, 16, 32, 64, 128, 256, 512, 1024, 2048, 4096, 8192, 16384]

  kinetic,enable-lcd-bias:
    description: Set if we want to output bias power supply for LCD.
    type: boolean

  kinetic,follower:
    $ref: /schemas/types.yaml#/definitions/phandle
    description: |
      Phandle to a second KTZ8866 that drives the remaining LED strings of the
      same panel. Brightness and enable state are mirrored to it so that both
      halves stay in lockstep behind a single backlight device.

  kinetic,follower-mode:
    description: |
      Set on a chip that is referenced by another KTZ8866 through
      kinetic,follower. Such a chip still applies its own configuration but
      does not register a backlight device of its own.
    type: boolean

required:
  - compatible
  - reg
  - vddpos-supply
  - vddneg-supply

unevaluatedProperties: false

examples:
  - |
    #include <dt-bindings/gpio/gpio.h>

    i2c {
        #address-cells = <1>;
        #size-cells = <0>;

        backlight@11 {
            compatible = "kinetic,ktz8866";
            reg = <0x11>;
            vddpos-supply = <&bl_vddpos_5p5>;
            vddneg-supply = <&bl_vddneg_5p5>;
            enable-gpios = <&tlmm 139 GPIO_ACTIVE_HIGH>;
            current-num-sinks = <5>;
            kinetic,current-ramp-delay-ms = <128>;
            kinetic,led-enable-ramp-delay-ms = <1>;
            kinetic,enable-lcd-bias;
        };
    };
```
