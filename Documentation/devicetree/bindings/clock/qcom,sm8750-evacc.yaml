## Documentation/devicetree/bindings/media/i2c/ovti,ov32d40.yaml
```yaml
# SPDX-License-Identifier: (GPL-2.0-only OR BSD-2-Clause)
%YAML 1.2
---
$id: http://devicetree.org/schemas/media/i2c/ovti,ov32d40.yaml#
$schema: http://devicetree.org/meta-schemas/core.yaml#

title: OmniVision OV32D40 CMOS Image Sensor

maintainers:
  - map220v <map220v300@gmail.com>

description:
  The OmniVision OV32D40 is a 32-megapixel CMOS image sensor that outputs
  10-bit Bayer data over a four-lane MIPI CSI-2 interface.

allOf:
  - $ref: /schemas/media/video-interface-devices.yaml#

properties:
  compatible:
    const: ovti,ov32d40

  reg:
    maxItems: 1

  clocks:
    description: 19.2 MHz sensor input clock
    maxItems: 1

  avdd-supply:
    description: Analog voltage supply, 2.8 volts

  vddd-supply:
    description: Digital core voltage supply, 1.2 volts

  vddio-supply:
    description: Digital I/O voltage supply, 1.8 volts

  reset-gpios:
    description:
      GPIO connected to the active-low sensor reset input.
    maxItems: 1

  port:
    $ref: /schemas/graph.yaml#/$defs/port-base
    additionalProperties: false

    properties:
      endpoint:
        $ref: /schemas/media/video-interfaces.yaml#
        unevaluatedProperties: false

        properties:
          data-lanes:
            items:
              - const: 1
              - const: 2
              - const: 3
              - const: 4

          link-frequencies:
            items:
              - const: 842400000

        required:
          - data-lanes
          - link-frequencies

    required:
      - endpoint

required:
  - compatible
  - reg
  - clocks
  - avdd-supply
  - vddd-supply
  - vddio-supply
  - reset-gpios
  - port

unevaluatedProperties: false

examples:
  - |
    #include <dt-bindings/gpio/gpio.h>

    i2c {
        #address-cells = <1>;
        #size-cells = <0>;

        camera@10 {
            compatible = "ovti,ov32d40";
            reg = <0x10>;

            clocks = <&camera_clk>;
            assigned-clocks = <&camera_clk>;
            assigned-clock-rates = <19200000>;

            avdd-supply = <&camera_avdd_2v8>;
            vddd-supply = <&camera_vddd_1v2>;
            vddio-supply = <&camera_vddio_1v8>;
            reset-gpios = <&gpio 7 GPIO_ACTIVE_LOW>;

            orientation = <0>;
            rotation = <270>;

            port {
                endpoint {
                    remote-endpoint = <&csi2_in>;
                    data-lanes = <1 2 3 4>;
                    link-frequencies = /bits/ 64 <842400000>;
                };
            };
        };
    };
...
```

## Documentation/devicetree/bindings/media/qcom,jpeg-encoder.yaml
```yaml
# SPDX-License-Identifier: (GPL-2.0 OR BSD-2-Clause)
%YAML 1.2
---
$id: http://devicetree.org/schemas/media/qcom,jpeg-encoder.yaml#
$schema: http://devicetree.org/meta-schemas/core.yaml#

title: Qualcomm JPEG Encoder

maintainers:
  - Atanas Filipov <atanas.filipov@oss.qualcomm.com>

description:
  Qualcomm JPEG Encoder is the JPEG encode hardware present in Qualcomm SoCs.

properties:
  compatible:
    enum:
      - qcom,sm8250-jenc

  reg:
    maxItems: 1

  interrupts:
    maxItems: 1

  clocks:
    maxItems: 6

  clock-names:
    items:
      - const: hf_axi
      - const: sf_axi
      - const: core_ahb
      - const: cpas_ahb
      - const: cnoc_axi
      - const: jpeg

  interconnects:
    maxItems: 3

  interconnect-names:
    items:
      - const: cpu-cfg
      - const: hf-mnoc
      - const: sf-mnoc

  iommus:
    maxItems: 1

  operating-points-v2: true

  opp-table:
    type: object

required:
  - compatible
  - reg
  - clocks
  - clock-names
  - interrupts
  - interconnects
  - interconnect-names
  - iommus

additionalProperties: false

examples:
  - |
    #include <dt-bindings/clock/qcom,camcc-sm8250.h>
    #include <dt-bindings/clock/qcom,gcc-sm8250.h>
    #include <dt-bindings/interconnect/qcom,icc.h>
    #include <dt-bindings/interconnect/qcom,sm8250.h>
    #include <dt-bindings/interrupt-controller/arm-gic.h>

    jpeg-encoder@ac53000 {
        compatible = "qcom,sm8250-jenc";
        reg = <0xac53000 0x1000>;

        interrupts = <GIC_SPI 474 IRQ_TYPE_EDGE_RISING>;

        clocks = <&gcc GCC_CAMERA_HF_AXI_CLK>,
                 <&gcc GCC_CAMERA_SF_AXI_CLK>,
                 <&camcc CAM_CC_CORE_AHB_CLK>,
                 <&camcc CAM_CC_CPAS_AHB_CLK>,
                 <&camcc CAM_CC_CAMNOC_AXI_CLK>,
                 <&camcc CAM_CC_JPEG_CLK>;
        clock-names = "hf_axi",
                      "sf_axi",
                      "core_ahb",
                      "cpas_ahb",
                      "cnoc_axi",
                      "jpeg";

        interconnects = <&gem_noc MASTER_AMPSS_M0 QCOM_ICC_TAG_ACTIVE_ONLY
                         &config_noc SLAVE_CAMERA_CFG QCOM_ICC_TAG_ACTIVE_ONLY>,
                        <&mmss_noc MASTER_CAMNOC_HF QCOM_ICC_TAG_ALWAYS
                         &mc_virt SLAVE_EBI_CH0 QCOM_ICC_TAG_ALWAYS>,
                        <&mmss_noc MASTER_CAMNOC_SF QCOM_ICC_TAG_ALWAYS
                         &mc_virt SLAVE_EBI_CH0 QCOM_ICC_TAG_ALWAYS>;
        interconnect-names = "cpu-cfg",
                             "hf-mnoc",
                             "sf-mnoc";

        iommus = <&apps_smmu 0x2040 0x400>;

        operating-points-v2 = <&jpeg_opp_table>;

        jpeg_opp_table: opp-table {
            compatible = "operating-points-v2";

            opp-100000000 {
                opp-hz = /bits/ 64 <400000000>,
                         /bits/ 64 <100000000>;
                opp-peak-kBps = <76800 104166 104166>;
                opp-avg-kBps = <38400 33569 33569>;
                required-opps = <&rpmhpd_opp_min_svs>;
            };

            opp-200000000 {
                opp-hz = /bits/ 64 <400000000>,
                         /bits/ 64 <200000000>;
                opp-peak-kBps = <76800 208333 208333>;
                opp-avg-kBps = <38400 67138 67138>;
                required-opps = <&rpmhpd_opp_low_svs>;
            };

            opp-400000000 {
                opp-hz = /bits/ 64 <400000000>,
                         /bits/ 64 <400000000>;
                opp-peak-kBps = <76800 416666 416666>;
                opp-avg-kBps = <38400 134277 134277>;
                required-opps = <&rpmhpd_opp_svs>;
            };

            opp-480000000 {
                opp-hz = /bits/ 64 <400000000>,
                         /bits/ 64 <480000000>;
                opp-peak-kBps = <76800 500000 500000>;
                opp-avg-kBps = <38400 161132 161132>;
                required-opps = <&rpmhpd_opp_svs_l1>;
            };

            opp-600000000 {
                opp-hz = /bits/ 64 <400000000>,
                         /bits/ 64 <600000000>;
                opp-peak-kBps = <76800 625000 625000>;
                opp-avg-kBps = <38400 201416 201416>;
                required-opps = <&rpmhpd_opp_nom>;
            };
        };
    };
```

## Documentation/devicetree/bindings/net/toshiba,tc9564-dwmac.yaml
```yaml
# SPDX-License-Identifier: (GPL-2.0-only OR BSD-2-Clause)
%YAML 1.2
---
$id: http://devicetree.org/schemas/net/toshiba,tc9564-dwmac.yaml#
$schema: http://devicetree.org/meta-schemas/core.yaml#

title: Toshiba TC956x Ethernet-AVB/TSN Controller

maintainers:
  - Alex Elder <elder@riscstar.com>
  - Daniel Thompson <daniel@riscstar.com>

description: |
  The Toshiba TC9564 (and more generally, TC956x) incorporates a PCIe
  gen 3 switch with one upstream and three downstream ports.  The first
  two downstream ports are exposed externally, while the third is used
  by an internal PCIe endpoint.  The PCIe endpoint implements two PCIe
  functions, and attached to each of these is a 10 Gbps capable Synopsys
  Ethernet controller.

  The TC956x additionally implements other internal IP blocks, and in
  particular it implements a GPIO controller.  Ten of the 35 GPIO lines
  implemented are exposed externally and are usable by the platform.
  It is platform-dependent whether the GPIO function must be exposed,
  and if it is, PCIe function 0 supplies it.

              ----------------------------------
              |              Host              |
              ------+...+----------+........+---
                    |i2c|          |  PCIe  |
    ----------------+...+----------+........+------
    | TC956x        |I2C|          |upstream|     |
    |               -----        --+--------+---  |
    |  -----  ------  -------    | PCIe switch |  |
    |  |SPI|  |GPIO|  |reset|    |             |  |
    |  -----  ------  |clock|    | DS3 DS2 DS1 |  |
    |                 -------    ---++--++--++--  |
    |  -----  ------     downstream//    \\  \\   |  downstream
    |  |MCU|  |SRAM|    /==========/      \\  \===== PCIe port 1
    |  -----  ------   //PCIe port 3       \\     |
    |                  ||                   \======= downstream
    |  ----+-----------++-----------+----         |  PCIe port 2
    |  | M | internal PCIe endpoint | M |         |
    |  | S |------------------------| S |  ------ |
    |  | I |   PCIe   |  |   PCIe   | I |  |UART| |
    |  | G |function 0|  |function 1| G |  ------ |
    |  | E |----++----|  |----++----| E |         |
    |  | N |  eMAC 0  |  |  eMAC 1  | N |         |
    --------+.......+------+.....+-----------------
            |USXGMII|      |SGMII|
          --+.......+--  --+.....+--
          |  ARQ113C  |  | QEP8121 |
          |    PHY    |  |   PHY   |
          -------------  -----------

properties:
  compatible:
    enum:
      - pci1179,0220 # Toshiba TC9564 (a.k.a. Qualcomm QPS615)

  gpio:
    type: object
    description: Embedded GPIO controller
    $ref: /schemas/gpio/gpio.yaml#

  ethernet:
    type: object
    description: XGMAC Ethernet controller
    $ref: /schemas/net/ethernet-controller.yaml#
    properties:
      mdio:
        $ref: snps,dwmac.yaml#/properties/mdio
    required:
      - mdio

required:
  - compatible

allOf:
  - $ref: /schemas/pci/pci-device.yaml#
  - $ref: /schemas/pci/pci-bus-common.yaml#

unevaluatedProperties: false

examples:
  - |
    pcie {
        #address-cells = <3>;
        #size-cells = <2>;

        pci@0,0 {
            compatible = "pci1179,0220";
            reg = <0x50000 0x0 0x0 0x0 0x0>;
            #address-cells = <3>;
            #size-cells = <2>;
            device_type = "pci";
            ranges;

            gpio {
                  gpio-controller;
                  #gpio-cells = <2>;
            };

            ethernet {
                phy-mode = "10gbase-r";
                phy-handle = <&tc9564_emac0_phy>;

                mdio {
                  compatible = "snps,dwmac-mdio";
                  #address-cells = <1>;
                  #size-cells = <0>;

                  tc9564_emac0_phy: ethernet-phy@1c {
                      compatible = "ethernet-phy-id311c.1c12";
                      reg = <0x1c>;
                  };
              };
            };
        };
    };
```

## Documentation/devicetree/bindings/phy/dioo,dio36600.yaml
```yaml
# SPDX-License-Identifier: GPL-2.0-only OR BSD-2-Clause
%YAML 1.2
---
$id: http://devicetree.org/schemas/phy/dioo,dio36600.yaml#
$schema: http://devicetree.org/meta-schemas/core.yaml#

title: Dioo DIO36600 1-port eUSB2 to USB 2.0 repeater

description:
  The repeater translates between eUSB2 and USB 2.0 signalling at Low, Full
  and High Speed, and negotiates its host or peripheral role in-band.  It
  comes up in a working configuration from power-on reset; the optional
  tuning properties below adjust the analog settings of either link for a
  board's channel.  Properties that are left out keep their power-on default.

maintainers:
  - Junhao Xie <bigfoot@radxa.com>

properties:
  compatible:
    const: dioo,dio36600

  reg:
    description:
      The ADDR pin picks one of four target addresses.  It is quaternary and
      is sampled once, after power-on reset - tie it to GND or to VDD1V8, or
      pull it up to VDD1V8 through 200 kOhm or 56 kOhm.
    enum: [0x43, 0x47, 0x4b, 0x4f]

  "#phy-cells":
    const: 0

  vdd1v8-supply:
    description: 1.8V supply

  vdd3v3-supply:
    description: 3.0V-3.6V supply for the USB 2.0 side

  reset-gpios:
    description:
      Active-low RST_N input.  It has a weak pull-up, so a design may leave it
      strapped high and rely on power-on reset instead.
    maxItems: 1

  dioo,auto-resume:
    type: boolean
    description:
      Host-side repeater feature.  The repeater drives K on both links during
      a remote wake until the host controller's resume starts, then passes
      the host's resume signalling to the USB 2.0 bus.

  dioo,eusb2-rx-squelch-threshold-microvolt:
    description: eUSB2 HS receiver squelch detection threshold.
    enum: [50000, 65000, 85000, 95000]
    default: 85000

  dioo,eusb2-rx-equalization-db:
    description: eUSB2 HS receiver equalization gain at 240 MHz over DC.
    enum: [0, 1, 2, 3, 4]
    default: 0

  dioo,eusb2-tx-swing-microvolt:
    description: eUSB2 HS transmitter output swing into a terminated link.
    enum: [180000, 200000, 220000, 240000]
    default: 200000

  dioo,eusb2-tx-de-emphasis-db:
    description: eUSB2 HS transmitter de-emphasis level.
    enum: [0, 1, 2, 3]
    default: 0

  dioo,usb2-rx-squelch-threshold-microvolt:
    description: USB 2.0 HS receiver squelch detection threshold.
    enum: [65000, 85000, 95000, 110000, 125000, 140000, 155000]
    default: 110000

  dioo,usb2-rx-equalization-db:
    description: USB 2.0 HS receiver equalization gain at 240 MHz over DC.
    enum: [0, 1, 2, 3, 4]
    default: 0

  dioo,usb2-tx-de-emphasis-db:
    description: USB 2.0 HS transmitter de-emphasis level.
    enum: [0, 1, 2, 3, 4, 5, 6]
    default: 2

  dioo,usb2-tx-de-emphasis-width-percent:
    description:
      Duration of the USB 2.0 HS transmitter de-emphasis, in percent of one
      HS unit interval.
    enum: [0, 50, 80]
    default: 80

  dioo,usb2-tx-swing-microvolt:
    description: USB 2.0 HS transmitter output swing into a terminated link.
    enum: [350000, 400000, 450000, 500000, 550000, 600000, 650000, 700000]
    default: 500000

  dioo,usb2-hs-rise-fall-time-ps:
    description:
      USB 2.0 HS transmitter slew rate, given as the upper bound of the
      rise/fall time range - 500-900 ps, 400-830 ps or 300-760 ps.
    enum: [900, 830, 760]
    default: 760

  dioo,usb2-fs-rise-fall-time-ns:
    description:
      USB 2.0 FS transmitter slew rate, given as the upper bound of the
      rise/fall time range - 8-20 ns or 4-14 ns.
    enum: [20, 14]
    default: 14

  dioo,usb2-hs-termination-ohms:
    description: USB 2.0 HS differential termination.
    enum: [100, 95, 90, 85, 80]
    default: 90

  dioo,usb2-hs-disconnect-threshold-microvolt:
    description: USB 2.0 HS disconnect detection threshold.
    enum: [575000, 675000, 775000, 875000]
    default: 575000

required:
  - compatible
  - reg
  - "#phy-cells"

additionalProperties: false

examples:
  - |
    #include <dt-bindings/gpio/gpio.h>

    i2c {
        #address-cells = <1>;
        #size-cells = <0>;

        repeater@43 {
            compatible = "dioo,dio36600";
            reg = <0x43>;
            #phy-cells = <0>;
            vdd1v8-supply = <&vreg_1p8>;
            vdd3v3-supply = <&vreg_3p0>;
            reset-gpios = <&tlmm 42 GPIO_ACTIVE_LOW>;

            dioo,usb2-tx-swing-microvolt = <450000>;
            dioo,usb2-hs-disconnect-threshold-microvolt = <675000>;
        };
    };
...
```
