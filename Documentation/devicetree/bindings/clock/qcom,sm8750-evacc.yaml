## Documentation/devicetree/bindings/power/supply/southchip,sc8541.yaml
```yaml
# SPDX-License-Identifier: (GPL-2.0-only OR BSD-2-Clause)
%YAML 1.2
---
$id: http://devicetree.org/schemas/power/supply/southchip,sc8541.yaml#
$schema: http://devicetree.org/meta-schemas/core.yaml#

title: Southchip SC8541 switched capacitor charger

maintainers:
  - Junhao Xie <bigfoot@radxa.com>

description:
  The SC8541 is a 2:1 and 4:1 switched capacitor charger, used next to a main
  charger so that a USB PD PPS adapter can deliver a higher charging current at
  a lower conversion loss. It is controlled over I2C and reports bus and
  battery voltage, current and die temperature through an internal ADC.

allOf:
  - $ref: power-supply.yaml#

properties:
  compatible:
    const: southchip,sc8541

  reg:
    maxItems: 1

  interrupts:
    maxItems: 1
    description: Alarm and fault interrupt, active low.

required:
  - compatible
  - reg

unevaluatedProperties: false

examples:
  - |
    #include <dt-bindings/interrupt-controller/irq.h>

    i2c {
        #address-cells = <1>;
        #size-cells = <0>;

        charger@6a {
            compatible = "southchip,sc8541";
            reg = <0x6a>;
            interrupt-parent = <&tlmm>;
            interrupts = <68 IRQ_TYPE_EDGE_FALLING>;
        };
    };
```

## Documentation/devicetree/bindings/power/supply/southchip,sc96231.yaml
```yaml
# SPDX-License-Identifier: (GPL-2.0-only OR BSD-2-Clause)
%YAML 1.2
---
$id: http://devicetree.org/schemas/power/supply/southchip,sc96231.yaml#
$schema: http://devicetree.org/meta-schemas/core.yaml#

title: Southchip SC96231 wireless power transceiver

maintainers:
  - Junhao Xie <bigfoot@radxa.com>

description:
  The SC96231 drives a wireless charging coil. On the boards it is found on
  only the transmitter side is wired up, so that the device can charge an
  accessory laid against its back.

allOf:
  - $ref: power-supply.yaml#

properties:
  compatible:
    const: southchip,sc96231

  reg:
    maxItems: 1

  interrupts:
    maxItems: 1

  reverse-txon-gpios:
    maxItems: 1
    description: Enables the coil driver.

  reverse-boost-gpios:
    maxItems: 1
    description: Enables the boost regulator feeding the coil driver.

required:
  - compatible
  - reg
  - reverse-txon-gpios
  - reverse-boost-gpios

unevaluatedProperties: false

examples:
  - |
    #include <dt-bindings/gpio/gpio.h>
    #include <dt-bindings/interrupt-controller/irq.h>

    i2c {
        #address-cells = <1>;
        #size-cells = <0>;

        charger@38 {
            compatible = "southchip,sc96231";
            reg = <0x38>;

            interrupt-parent = <&tlmm>;
            interrupts = <78 IRQ_TYPE_EDGE_FALLING>;

            reverse-txon-gpios = <&tlmm 14 GPIO_ACTIVE_HIGH>;
            reverse-boost-gpios = <&tlmm 120 GPIO_ACTIVE_HIGH>;
        };
    };
```

## Documentation/devicetree/bindings/sound/foursemi,fs19xx.yaml
```yaml
# SPDX-License-Identifier: (GPL-2.0-only OR BSD-2-Clause)
%YAML 1.2
---
$id: http://devicetree.org/schemas/sound/foursemi,fs19xx.yaml#
$schema: http://devicetree.org/meta-schemas/core.yaml#

title: FourSemi FS19xx smart speaker amplifier

maintainers:
  - Junhao Xie <bigfoot@radxa.com>

description:
  A boosted class-D speaker amplifier with an I2S input, an I2S feedback
  output carrying the measured speaker current and voltage, and an I2C
  control port. Several parts share the FS19xx register map and report a
  device ID of either 0x17 or 0x29.

allOf:
  - $ref: dai-common.yaml#

properties:
  compatible:
    const: foursemi,fs19xx

  reg:
    maxItems: 1

  reset-gpios:
    maxItems: 1
    description:
      Active-low shutdown pin of the amplifier. Holding it low powers the
      analogue blocks down; releasing it brings the part up. The register
      file itself is reset over I2C.

  interrupts:
    maxItems: 1

  foursemi,i2s-channel:
    $ref: /schemas/types.yaml#/definitions/uint32
    enum: [1, 2, 3]
    default: 3
    description: |
      Which I2S channel the amplifier reproduces:
        1 - left
        2 - right
        3 - the sum of both

  '#sound-dai-cells':
    const: 0

  sound-name-prefix: true

required:
  - compatible
  - reg
  - '#sound-dai-cells'

unevaluatedProperties: false

examples:
  - |
    #include <dt-bindings/gpio/gpio.h>

    i2c {
        #address-cells = <1>;
        #size-cells = <0>;

        speaker@34 {
            compatible = "foursemi,fs19xx";
            reg = <0x34>;
            #sound-dai-cells = <0>;
            reset-gpios = <&tlmm 128 GPIO_ACTIVE_LOW>;
            foursemi,i2s-channel = <1>;
            sound-name-prefix = "SpkTopLeft";
        };
    };
```

## drivers/iio/common/Kconfig
```kconfig
# SPDX-License-Identifier: GPL-2.0-only
#
# IIO common modules
#

config IIO_QCOM_SENSING_HUB
	tristate "Qualcomm Sensing Hub IIO bridge"
	depends on (ARCH_QCOM || COMPILE_TEST) && NET && OF && QRTR
	select IIO_BUFFER
	select IIO_KFIFO_BUF
	select QCOM_QMI_HELPERS
	help
	  Say yes to expose sensors managed by a Qualcomm Sensing Hub through
	  standard Industrial I/O devices on supported machines. The physical
	  sensor buses remain
	  controlled by the remote sensor processor; samples are received over
	  the QSH QMI client service.

source "drivers/iio/common/cros_ec_sensors/Kconfig"
source "drivers/iio/common/hid-sensors/Kconfig"
source "drivers/iio/common/inv_sensors/Kconfig"
source "drivers/iio/common/ms_sensors/Kconfig"
source "drivers/iio/common/scmi_sensors/Kconfig"
source "drivers/iio/common/ssp_sensors/Kconfig"
source "drivers/iio/common/st_sensors/Kconfig"
```

## drivers/media/platform/qcom/jpeg/Kconfig
```kconfig
# SPDX-License-Identifier: GPL-2.0-only
config VIDEO_QCOM_JENC
	tristate "Qualcomm V4L2 JPEG Encoder driver"
	depends on V4L_MEM2MEM_DRIVERS
	depends on (ARCH_QCOM && IOMMU_DMA) || COMPILE_TEST
	depends on VIDEO_DEV
	select VIDEOBUF2_DMA_SG
	select V4L2_JPEG_HELPER
	select V4L2_MEM2MEM_DEV
	help
	  V4L2 mem2mem driver for the Qualcomm JPEG encoder hardware
	  found in Snapdragon SoCs.

	  To compile this driver as a module, choose M here: the
	  module will be called qcom-jenc.
```
