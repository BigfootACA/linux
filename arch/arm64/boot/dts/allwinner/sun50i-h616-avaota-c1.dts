// SPDX-License-Identifier: (GPL-2.0+ or MIT)
/*
 * Copyright (C) 2025 BigfootACA <bigfoot@classfun.cn>.
 */

/dts-v1/;

#include "sun50i-h616.dtsi"
#include "sun50i-h616-cpu-opp.dtsi"
#include "sun50i-h616-yuzuki-chameleon-base.dtsi"

/ {
	model = "Avaota C1";
	compatible = "avaota-c1", "allwinner,sun50i-h616";
};

/* AICSemi AIC8800 WiFi */
&mmc1 {
	status = "okay";
};

/* AICSemi AIC8800 Bluetooth */
&uart1 {
	status = "okay";
};
